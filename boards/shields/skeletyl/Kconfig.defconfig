## boards/shields/skeletyl/Kconfig.defconfig
```kconfig
if SHIELD_SKELETYL_DONGLE || SHIELD_SKELETYL_LEFT || SHIELD_SKELETYL_RIGHT

config ZMK_SPLIT
    default y

endif # SHIELD_SKELETYL_DONGLE || SHIELD_SKELETYL_LEFT || SHIELD_SKELETYL_RIGHT

if SHIELD_SKELETYL_DONGLE

config ZMK_KEYBOARD_NAME
    default "skeletyl-w"

config ZMK_SPLIT_ROLE_CENTRAL
    default y

endif # SHIELD_SKELETYL_DONGLE
```
